## main/Kconfig.projbuild
```kconfig
menu "Vice City Map Configuration"

    config WIFI_SSID
        string "WiFi SSID"
        default "your_wifi_ssid"

    config WIFI_PASSWORD
        string "WiFi Password"
        default "your_wifi_password"

    config GOOGLE_MAPS_API_KEY
        string "Google Maps Static API Key"
        default "YOUR_API_KEY_HERE"

    config GPS_UART_PORT
        int "GPS UART port number"
        default 1
        range 0 2

    config GPS_UART_TX
        int "GPS UART TX GPIO"
        default 43

    config GPS_UART_RX
        int "GPS UART RX GPIO"
        default 44

    config GPS_UART_BAUD
        int "GPS UART baud rate"
        default 9600

    config MAP_ZOOM_LEVEL
        int "Google Maps zoom level"
        default 16
        range 1 20

    config MAP_FETCH_INTERVAL_MS
        int "Map tile fetch interval (ms)"
        default 5000
        range 1000 60000

endmenu
```

## sdkconfig.defaults
```kconfig
# Target
CONFIG_IDF_TARGET="esp32s3"

# Flash size
CONFIG_ESPTOOLPY_FLASHSIZE_8MB=y
CONFIG_PARTITION_TABLE_CUSTOM=y
CONFIG_PARTITION_TABLE_CUSTOM_FILENAME="partitions.csv"

# PSRAM (Waveshare module has PSRAM)
CONFIG_SPIRAM=y
CONFIG_SPIRAM_MODE_OCT=y
CONFIG_SPIRAM_SPEED_80M=y

# WiFi
CONFIG_ESP_WIFI_STATIC_RX_BUFFER_NUM=10
CONFIG_ESP_WIFI_DYNAMIC_RX_BUFFER_NUM=32

# HTTP client
CONFIG_ESP_HTTP_CLIENT_ENABLE_HTTPS=y

# JPEG decoder
CONFIG_JD_USE_FLASH=y

# FreeRTOS
CONFIG_FREERTOS_HZ=1000

# Log level
CONFIG_LOG_DEFAULT_LEVEL_INFO=y

# Task watchdog
CONFIG_ESP_TASK_WDT_TIMEOUT_S=30
```
